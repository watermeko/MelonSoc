## src/Kconfig
```kconfig
mainmenu "MelonSoc Configuration"

choice
	prompt "DDR application"
	default DDR_APP_RTOS

config DDR_APP_RTOS
	bool "FreeRTOS test application"

config DDR_APP_LINUX
	bool "OpenSBI + Linux + BusyBox"

endchoice

menu "Test Commands"

config APP_TEST_M
	bool "Enable test-m (M extension: multiply/divide)"
	default y

config APP_TEST_CSR
	bool "Enable test-csr (CSR read/write and ECALL trap)"
	default y

config APP_TEST_IRQ
	bool "Enable test-irq (timer peripheral interrupt)"
	default y

config APP_TEST_MSIP
	bool "Enable test-msip (machine software interrupt)"
	default y

config APP_TEST_MTIME
	bool "Enable test-mtime (machine timer interrupt)"
	default y

config APP_TEST_SHIFT
	bool "Enable test-shift (SRA/SRAI and uint16 CRC)"
	default y

config APP_TEST_A
	bool "Enable test-a (RISC-V A extension LR/SC/AMO)"
	default y

endmenu
```

## src/program/ddr_app/linux/board/melonsoc/opensbi/platform/melonsoc/Kconfig
```kconfig
# SPDX-License-Identifier: BSD-2-Clause

config PLATFORM_MELONSOC
	bool
	select TIMER_MTIMER
	default y
```

## src/program/ddr_app/linux/configs/melonsoc_defconfig
```kconfig
BR2_riscv=y
BR2_riscv_custom=y
BR2_RISCV_ISA_RVM=y
BR2_RISCV_ISA_RVA=y
BR2_RISCV_ISA_RVC=y
BR2_RISCV_32=y
BR2_TOOLCHAIN_BUILDROOT_MUSL=y
BR2_GCC_VERSION_13_X=y
BR2_KERNEL_HEADERS_AS_KERNEL=y
BR2_PACKAGE_HOST_LINUX_HEADERS_CUSTOM_6_6=y
BR2_STATIC_LIBS=y
BR2_OPTIMIZE_S=y
BR2_SSP_NONE=y
BR2_TARGET_GENERIC_HOSTNAME="melonsoc"
BR2_TARGET_GENERIC_ISSUE="MelonSoc Buildroot"
BR2_INIT_BUSYBOX=y
BR2_SYSTEM_BIN_SH_BUSYBOX=y
BR2_TARGET_GENERIC_GETTY_PORT="hvc0"
# BR2_TARGET_GENERIC_REMOUNT_ROOTFS_RW is not set
BR2_ROOTFS_DEVICE_CREATION_DYNAMIC_DEVTMPFS=y
BR2_ROOTFS_OVERLAY="$(BR2_EXTERNAL_MELONSOC_PATH)/board/melonsoc/rootfs-overlay"
BR2_GLOBAL_PATCH_DIR="$(BR2_EXTERNAL_MELONSOC_PATH)/board/melonsoc/patches"
BR2_DOWNLOAD_FORCE_CHECK_HASHES=y
BR2_PACKAGE_BUSYBOX_CONFIG="package/busybox/busybox-minimal.config"
BR2_PACKAGE_BUSYBOX_CONFIG_FRAGMENT_FILES="$(BR2_EXTERNAL_MELONSOC_PATH)/board/melonsoc/busybox.fragment"
# BR2_PACKAGE_IFUPDOWN_SCRIPTS is not set
BR2_LINUX_KERNEL=y
BR2_LINUX_KERNEL_CUSTOM_VERSION=y
BR2_LINUX_KERNEL_CUSTOM_VERSION_VALUE="6.6"
BR2_LINUX_KERNEL_USE_CUSTOM_CONFIG=y
BR2_LINUX_KERNEL_CUSTOM_CONFIG_FILE="$(BR2_EXTERNAL_MELONSOC_PATH)/board/melonsoc/linux.config"
BR2_LINUX_KERNEL_DTS_SUPPORT=y
BR2_LINUX_KERNEL_CUSTOM_DTS_PATH="$(BR2_EXTERNAL_MELONSOC_PATH)/board/melonsoc/melonsoc.dts"
BR2_LINUX_KERNEL_IMAGE=y
BR2_TARGET_ROOTFS_INITRAMFS=y
# BR2_TARGET_ROOTFS_TAR is not set
BR2_TARGET_OPENSBI=y
BR2_TARGET_OPENSBI_CUSTOM_VERSION=y
BR2_TARGET_OPENSBI_CUSTOM_VERSION_VALUE="1.7"
BR2_TARGET_OPENSBI_PLAT="melonsoc"
# BR2_TARGET_OPENSBI_INSTALL_DYNAMIC_IMG is not set
# BR2_TARGET_OPENSBI_INSTALL_JUMP_IMG is not set
BR2_TARGET_OPENSBI_LINUX_PAYLOAD=y
BR2_TARGET_OPENSBI_ADDITIONAL_VARIABLES="PLATFORM_DIR=$(BR2_EXTERNAL_MELONSOC_PATH)/board/melonsoc/opensbi/platform FW_TEXT_START=0x80000000 FW_FDT_PATH=$(BINARIES_DIR)/melonsoc.dtb"
BR2_ROOTFS_POST_IMAGE_SCRIPT="$(BR2_EXTERNAL_MELONSOC_PATH)/board/melonsoc/post-image.sh"
```
